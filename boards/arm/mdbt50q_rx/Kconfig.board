## boards/arm/mdbt50q_rx/Kconfig.board
```kconfig
# SPDX-License-Identifier: Apache-2.0

config BOARD_MDBT50Q_RX
    bool "RAYTAC MDBT50Q-RX"
    depends on SOC_NRF52840_QIAA
```

## boards/arm/mdbt50q_rx/Kconfig.defconfig
```kconfig
# SPDX-License-Identifier: Apache-2.0

if BOARD_MDBT50Q_RX

config BOARD
    default "mdbt50q_rx"

config SOC
    default "nrf52840_qiaa"

config BOARD_ENABLE_DCDC
    default y

config GPIO
    default y

config SERIAL
    default y

config UART_CONSOLE
    default y

config USB_NRFX
    default y

config USB_DEVICE_STACK
    default y

config BT
    default y

config BT_CTLR
    default y

endif
```

## boards/shields/roBa/Kconfig.defconfig
```kconfig
# R側の設定：Central記述を削除し、純粋なPeripheral（子機）にします
if SHIELD_ROBA_R
config ZMK_KEYBOARD_NAME
    default "roBa_R"
config ZMK_SPLIT
    default y
endif

# L側の設定：変更なし
if SHIELD_ROBA_L
config ZMK_KEYBOARD_NAME
    default "roBa_L"
config ZMK_SPLIT
    default y
endif

# ▼▼▼ ドングル設定を追加（ここが新しい親機になります） ▼▼▼
if SHIELD_ROBA_DONGLE
config ZMK_KEYBOARD_NAME
    default "roBa_Dongle"
config ZMK_SPLIT
    default y
config ZMK_SPLIT_ROLE_CENTRAL
    default y
endif
```

## boards/shields/roBa/Kconfig.shield
```kconfig
config SHIELD_ROBA_R
    def_bool $(shields_list_contains,roBa_R)

config SHIELD_ROBA_L
    def_bool $(shields_list_contains,roBa_L)

# ▼▼▼ 以下を追加 ▼▼▼
config SHIELD_ROBA_DONGLE
    def_bool $(shields_list_contains,roBa_dongle)
```

## config/west.yml
```yaml
manifest:
  remotes:
    - name: zmkfirmware
      url-base: https://github.com/zmkfirmware
    - name: englmaxi
      url-base: https://github.com/englmaxi
  projects:
    - name: zmk
      remote: zmkfirmware
      revision: main
      import: app/west.yml
    # ▼▼▼ 重複エラー回避のため、pmw3610ドライバは削除（ZMK標準を使います） ▼▼▼
    - name: zmk-dongle-display
      remote: englmaxi
      revision: main
      path: modules/drivers/zmk-dongle-display
  self:
    path: config
```
